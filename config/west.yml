## config/west.yml
```yaml
manifest:
  defaults:
    revision: v0.3
  remotes:
    - name: zmkfirmware
      url-base: https://github.com/zmkfirmware
    # Additional modules containing boards/shields/custom code can be listed here as well
    # See https://docs.zephyrproject.org/3.2.0/develop/west/manifest.html#projects
    - name: m165437
      url-base: https://github.com/M165437
    - name: urob
      url-base: https://github.com/urob
  projects:
    - name: zmk
      remote: zmkfirmware
      import: app/west.yml
    - name: nice-view-gem
      remote: m165437
      revision: v0.3.0 # pinned to a specific commit
    - name: zmk-helpers
      remote: urob
      revision: main # Should match ZMK release.
      # revision: v0.3 # Should match ZMK release.
    # - name: zmk-auto-layer
    #   remote: urob
    #   revision: v0.3 # Should match ZMK release.
  self:
    path: config
```
